## arch/mips/noop/Kconfig
```kconfig
choice
	prompt "Machine type"
	depends on MACH_NOOP
	default NOOP_SOC_ON_BOARD

config NOOP_SOC_ON_BOARD
    bool "NJU OoO on board"

config NOOP_SOC_EMU
    bool "NJU OoO on emulator"

endchoice
```
